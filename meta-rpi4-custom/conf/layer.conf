## meta-rpi4-custom/conf/layer.conf
```bitbake
BBPATH .= ":${LAYERDIR}"

BBFILES += "${LAYERDIR}/recipes-*/*/*.bb \
            ${LAYERDIR}/recipes-*/*/*.bbappend"

BBFILE_COLLECTIONS += "rpi4-custom"
BBFILE_PATTERN_rpi4-custom = "^${LAYERDIR}/"
BBFILE_PRIORITY_rpi4-custom = "10"

LAYERDEPENDS_rpi4-custom = "core"
LAYERSERIES_COMPAT_rpi4-custom = "scarthgap"
```
